// SPDX-License-Identifier: (GPL-2.0+ OR MIT)
/*
 * Copyright 2026 Cargt
 */

/dts-v1/;

#include "imx95-cargt-00414-00365.dts"
#include "imx95-cargt-00414-00365-glt0557201280is1.dtsi"

/ {
	model = "Cargt i.MX95 00414 OSM-L SOM on 00365 carrier board with 5.5-in MIPI-DSI Display (GLT0557201280IS1-CTP)";
};
