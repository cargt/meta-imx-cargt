// SPDX-License-Identifier: (GPL-2.0+ OR MIT)
/*
 * Copyright 2026 Cargt
 *
 * 00363 + 00428 with the 5.5" MIPI DSI panel, with the Cortex-M33 under
 * Linux remoteproc and RPMsg. LPUART2 (mikroBUS UART) is left to the M33
 * firmware's debug console.
 */

#include "imx93-cargt-00363-00428-glt0557201280is1.dts"
#include "imx93-cargt-00363-rpmsg.dtsi"

/ {
	model = "Cargt i.MX93 00428 carrier board with 5.5-in MIPI DSI Display(GLT0557201280IS1-CTP), with M33 RPMsg";
};
