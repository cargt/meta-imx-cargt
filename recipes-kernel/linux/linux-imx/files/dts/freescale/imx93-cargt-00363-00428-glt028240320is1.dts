// SPDX-License-Identifier: (GPL-2.0+ OR MIT)
/*
 * Copyright 2022 NXP
 */

/dts-v1/;

#include "imx93-cargt-00363-00428.dts"
#include "imx93-cargt-00363-00428-glt028240320is1.dtsi"

/ {
	model = "Cargt i.MX93 00363 OSM-L SOM on 00428 carrier board with 2.8in SPI Display(GLT028240320IS1-CTP)";
};
