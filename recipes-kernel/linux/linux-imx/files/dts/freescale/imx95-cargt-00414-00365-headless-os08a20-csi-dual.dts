// SPDX-License-Identifier: (GPL-2.0+ OR MIT)
/*
 * Copyright 2026 Cargt
 *
 * 00414 + 00365 with no panel and OS08A20 on CSI-1 and CSI-2. The headless display
 * pipeline keeps the DPU bound, so /dev/dri, the GPU, Weston and G2D (which
 * goes through the DPU on i.MX 95) work without a panel attached.
 */

/dts-v1/;

#include "imx95-cargt-00414-00365.dts"
#include "imx95-cargt-00414-00365-headless.dtsi"
#include "imx95-cargt-00414-00365-os08a20-csi-dual.dtsi"

/ {
	model = "Cargt i.MX95 00414 OSM-L SOM on 00365 carrier board, headless (GPU, no panel), with OS08A20 on CSI-1 and CSI-2";
};
