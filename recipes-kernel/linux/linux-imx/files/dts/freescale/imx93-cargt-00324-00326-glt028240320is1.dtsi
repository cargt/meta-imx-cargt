&lpspi4 {
	fsl,spi-num-chipselects = <1>;
	pinctrl-names = "default", "sleep";
	pinctrl-0 = <&pinctrl_lpspi4>;
	pinctrl-1 = <&pinctrl_lpspi4>;
	cs-gpios = <&gpio2 18 GPIO_ACTIVE_LOW>;
	status = "okay";

	/delete-property/ dmas;
	/delete-property/ dma-names;

	display@0{
		compatible = "gtdisplay,glt028240320IS1", "sitronix,st7789t3";
		reg = <0>;
		spi-max-frequency = <24000000>;
		dc-gpios = <&gpio2 4 GPIO_ACTIVE_HIGH>;
		reset-gpios = <&pca9555 1 GPIO_ACTIVE_HIGH>;
	};
};

&iomuxc {
	pinctrl_lpspi4: lpspi4grp {
		fsl,pins = <
			MX93_PAD_GPIO_IO18__GPIO2_IO18		0x3fe
			MX93_PAD_GPIO_IO04__GPIO2_IO04		0x3fe
			MX93_PAD_GPIO_IO19__LPSPI4_SIN		0x3fe
			MX93_PAD_GPIO_IO20__LPSPI4_SOUT		0x3fe
			MX93_PAD_GPIO_IO21__LPSPI4_SCK		0x3fe
		>;
	};
};
