// SPDX-License-Identifier: (GPL-2.0+ OR MIT)
/*
 * Copyright 2026 Cargt
 */

/dts-v1/;

#include "imx95-cargt-00414-00365.dts"
#include "imx95-cargt-00414-00365-headless.dtsi"

/ {
	model = "Cargt i.MX95 00414 OSM-L SOM on 00365 carrier board, headless (GPU, no panel)";
};
