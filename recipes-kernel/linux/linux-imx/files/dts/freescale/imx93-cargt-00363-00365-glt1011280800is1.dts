// SPDX-License-Identifier: (GPL-2.0+ OR MIT)
/*
 * Copyright 2022 NXP
 */

 /dts-v1/;

 #include <dt-bindings/usb/pd.h>
 #include <dt-bindings/pwm/pwm.h>
 #include "imx93-cargt-00363-00365.dts"
 #include "imx93-cargt-00363-00365-glt1011280800is1.dtsi"
 
/ {
	model = "Cargt i.MX93 00365 carrier board with 10-in LVDS Display(GLT10111280800IS1-CTP)";
};
