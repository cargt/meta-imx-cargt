// SPDX-License-Identifier: (GPL-2.0+ OR MIT)
/*
 * Copyright 2026 Cargt
 *
 * 00363 + 00365 with the 10.1" LVDS panel, with the Cortex-M33 under Linux
 * remoteproc and RPMsg. LPUART2 (mikroBUS UART) is left to the M33
 * firmware's debug console.
 */

#include "imx93-cargt-00363-00365-glt1011280800is1.dts"
#include "imx93-cargt-00363-rpmsg.dtsi"

/ {
	model = "Cargt i.MX93 00365 carrier board with 10-in LVDS Display(GLT1011280800IS1-CTP), with M33 RPMsg";
};
