// SPDX-License-Identifier: (GPL-2.0+ OR MIT)
/*
 * Copyright 2026 Cargt
 *
 * 00414 + 00365 with the 10.1" LVDS panel and OS08A20 on CSI-2.
 */

/dts-v1/;

#include "imx95-cargt-00414-00365.dts"
#include "imx95-cargt-00414-00365-glt1011280800is1.dtsi"
#include "imx95-cargt-00414-00365-os08a20-csi2.dtsi"

/ {
	model = "Cargt i.MX95 00414 OSM-L SOM on 00365 carrier board with 10.1-in LVDS Display (GLT1011280800IS1-CTP) and OS08A20 on CSI-2";
};
