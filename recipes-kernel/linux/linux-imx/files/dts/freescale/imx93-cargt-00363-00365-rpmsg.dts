// SPDX-License-Identifier: (GPL-2.0+ OR MIT)
/*
 * Copyright 2026 Cargt
 *
 * 00363 + 00365, with the Cortex-M33 under Linux remoteproc and RPMsg.
 * LPUART2 (mikroBUS UART) is left to the M33 firmware's debug console.
 */

#include "imx93-cargt-00363-00365.dts"
#include "imx93-cargt-00363-rpmsg.dtsi"

/ {
	model = "Cargt i.MX93 00363 OSM-L SOM on 00365 carrier board, with M33 RPMsg";
};
