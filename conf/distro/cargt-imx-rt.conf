## conf/distro/cargt-imx-wayland.conf
```bitbake
include conf/distro/include/cargt-imx-base.inc
include conf/distro/include/cargt-imx-preferred-env.inc

DISTRO = "cargt-imx-wayland"

INIT_MANAGER = "systemd"

# Remove conflicting backends
DISTRO_FEATURES:remove = "directfb x11 "
DISTRO_FEATURES:append = " wayland pam systemd"

NETWORK_MANAGER = "networkmanager"
RDEPENDS:packagegroup-core-tools-testapps:remove = "connman-tools connman-tests connman-client "

VIRTUAL-RUNTIME_syslog = ""
VIRTUAL-RUNTIME_base-utils-syslog = ""
```

## conf/distro/cargt-imx-xwayland-ap.conf
```bitbake
include conf/distro/include/cargt-imx-base.inc
include conf/distro/include/cargt-imx-preferred-env.inc

DISTRO = "cargt-imx-xwayland-ap"

INIT_MANAGER = "systemd"

# Remove conflicting backends
DISTRO_FEATURES:remove = "directfb "
DISTRO_FEATURES:append = " x11 wayland pam systemd cargt-ap"

NETWORK_MANAGER = "systemd"
RDEPENDS:packagegroup-core-tools-testapps:remove = "connman-tools connman-tests connman-client "

VIRTUAL-RUNTIME_syslog = ""
VIRTUAL-RUNTIME_base-utils-syslog = ""
```

## conf/distro/cargt-imx-xwayland-connman.conf
```bitbake
include conf/distro/include/cargt-imx-base.inc
include conf/distro/include/cargt-imx-preferred-env.inc

DISTRO = "cargt-imx-xwayland"

INIT_MANAGER = "systemd"

# Remove conflicting backends
DISTRO_FEATURES:remove = "directfb "
DISTRO_FEATURES:append = " x11 wayland pam systemd connman"

VIRTUAL-RUNTIME_syslog = ""
VIRTUAL-RUNTIME_base-utils-syslog = ""
```

## conf/distro/cargt-imx-xwayland.conf
```bitbake
include conf/distro/include/cargt-imx-base.inc
include conf/distro/include/cargt-imx-preferred-env.inc

DISTRO = "cargt-imx-xwayland"

INIT_MANAGER = "systemd"

# Remove conflicting backends
DISTRO_FEATURES:remove = "directfb "
DISTRO_FEATURES:append = " x11 wayland pam systemd networkmanager"

NETWORK_MANAGER = "networkmanager"
RDEPENDS:packagegroup-core-tools-testapps:remove = "connman-tools connman-tests connman-client "

VIRTUAL-RUNTIME_syslog = ""
VIRTUAL-RUNTIME_base-utils-syslog = ""
```

## conf/layer.conf
```bitbake
# We have a conf and classes directory, add to BBPATH
BBPATH .= ":${LAYERDIR}"

# We have a packages directory, add to BBFILES
BBFILES += "${LAYERDIR}/recipes-*/*/*.bb \
            ${LAYERDIR}/recipes-*/*/*.bbappend"

BBFILE_COLLECTIONS += "imx-cargt-release"
BBFILE_PATTERN_imx-cargt-release := "^${LAYERDIR}/"
BBFILE_PRIORITY_imx-cargt-release = "10"
LAYERSERIES_COMPAT_imx-cargt-release = "wrynose"

# Overrides for imx93-11x11-lpddr4x-frdm.conf
MACHINE_FEATURES:append:imx93-11x11-lpddr4x-frdm = " dpdk nxpwifi-all-sdio"
MACHINE_FIRMWARE:append:imx93-11x11-lpddr4x-frdm = " ethos-u-firmware"
WKS_FILE_DEPENDS:append:imx93-11x11-lpddr4x-frdm = " imx-m33-demos"
IMAGE_BOOT_FILES:append:imx93-11x11-lpddr4x-frdm = " \
    imx93-11x11-evk_m33_TCM_power_mode_switch.bin \
    imx93-11x11-evk_m33_TCM_rpmsg_lite_pingpong_rtos_linux_remote.bin \
    imx93-11x11-evk_m33_TCM_rpmsg_lite_str_echo_rtos.bin \
"
IMXBOOT_TARGETS:imx93-11x11-lpddr4x-frdm = "${@bb.utils.contains('UBOOT_CONFIG', 'ecc', '${IMXBOOT_TARGETS_ECC}', '${IMXBOOT_TARGETS_SD}', d)}"

# Overrides for imx8mp-lpddr4-frdm
MACHINE_FEATURES:append:imx8mp-lpddr4-frdm = " optee nxpwifi-all-pcie nxpwifi-all-sdio dpdk"
WKS_FILE_DEPENDS:append:imx8mp-lpddr4-frdm = " imx-m7-demos"
IMAGE_BOOT_FILES:append:imx8mp-lpddr4-frdm = " \
    imx8mp_m7_TCM_hello_world.bin \
    imx8mp_m7_TCM_low_power_wakeword.bin \
    imx8mp_m7_TCM_rpmsg_lite_pingpong_rtos_linux_remote.bin \
    imx8mp_m7_TCM_rpmsg_lite_str_echo_rtos.bin \
    imx8mp_m7_TCM_sai_low_power_audio.bin \
"

# Overrides for imx95-15x15-lpddr4x-frdm and imx95-19x19-lpddr5-frdm-pro:
# use the Cargt A/B rootfs layout. Needs the matching U-Boot env change in
# 0030-imx95_frdm-boot-the-Cargt-A-B-rootfs-layout.patch.
WKS_FILE:imx95-15x15-lpddr4x-frdm = "cargt-dev.wks.in"
WKS_FILE:imx95-19x19-lpddr5-frdm-pro = "cargt-dev.wks.in"
# These boards boot from eMMC or SD, so fw_env.config must follow the boot device
MACHINE_FEATURES:append:imx95-15x15-lpddr4x-frdm = " fw-env-bootdev"
MACHINE_FEATURES:append:imx95-19x19-lpddr5-frdm-pro = " fw-env-bootdev"
```

## conf/machine/imx91-cargt-00363-00365.conf
```bitbake
#@TYPE: Machine
#@NAME: Cargt NXP i.MX 91
#@SOC: i.MX91
#@DESCRIPTION: Machine configuration for Cargt NXP i.MX 91 00363 SOM on 00365 carrier board
#@MAINTAINER: Tim Carney <tim.carney@cargt.com>

MACHINEOVERRIDES =. "mx91:"

require include/imx91-cargt.inc

KERNEL_DEVICETREE_BASENAME = "imx91-cargt-00363-00365"

KERNEL_DTB = "${KERNEL_DEVICETREE_BASENAME}.dtb"

UBOOT_DTB_NAME = "imx91-cargt-00363-00365.dtb"
UBOOT_CONFIG_BASENAME = "imx91-cargt-00363-00365"

DDR_FIRMWARE_NAME = " \
    lpddr4_dmem_1d_v202201.bin \
    lpddr4_dmem_2d_v202201.bin \
    lpddr4_imem_1d_v202201.bin \
    lpddr4_imem_2d_v202201.bin \
"

MACHINE_FEATURES:append = " rdp 00363 00365 "

WKS_FILE = "cargt-dev.wks.in"

PACKAGE_FEED_ARCHS = "all  armv8a  armv8a-mx91  imx91_cargt_00363_00365"
PACKAGE_FEED_BASE_PATHS = ""
PACKAGE_FEED_URIS = "https://yocto.cargt.com/linux-imx/scarthgap"
```

## conf/machine/imx91-cargt-00363-osm-som.conf
```bitbake
#@TYPE: Machine
#@NAME: Cargt NXP i.MX 91
#@SOC: i.MX91
#@DESCRIPTION: Machine configuration for Cargt NXP i.MX 91 00363 OSM-L SOM
#@MAINTAINER: Tim Carney <tim.carney@cargt.com>

MACHINEOVERRIDES =. "mx91:"

require include/imx91-cargt.inc

KERNEL_DEVICETREE_BASENAME = "imx91-cargt-00363-osm-som"

KERNEL_DTB = "${KERNEL_DEVICETREE_BASENAME}.dtb"

UBOOT_DTB_NAME = "imx91-cargt-00363-osm-som.dtb"
UBOOT_CONFIG_BASENAME = "imx91-cargt-00363-osm-som"

DDR_FIRMWARE_NAME = " \
    lpddr4_dmem_1d_v202201.bin \
    lpddr4_dmem_2d_v202201.bin \
    lpddr4_imem_1d_v202201.bin \
    lpddr4_imem_2d_v202201.bin \
"

MACHINE_FEATURES:append = " rdp nxpwifi-nxpiw612-sdio 00363 "

WKS_FILE = "cargt-dev.wks.in"

PACKAGE_FEED_ARCHS = "all  armv8a  armv8a-mx91  imx91_cargt_00363_osm_som"
PACKAGE_FEED_BASE_PATHS = ""
PACKAGE_FEED_URIS = "https://yocto.cargt.com/linux-imx/scarthgap"
```

## conf/machine/imx93-cargt-00324-00326.conf
```bitbake
#@TYPE: Machine
#@NAME: Cargt NXP i.MX 93
#@SOC: i.MX93
#@DESCRIPTION: Machine configuration for Cargt NXP i.MX 93 00324 SOM
#@MAINTAINER: Tim Carney <tim.carney@cargt.com>

MACHINEOVERRIDES =. "mx93:"

require include/imx93-cargt.inc

KERNEL_DEVICETREE_BASENAME = "imx93-cargt-00324-00326"

KERNEL_DEVICETREE = " \
    freescale/${KERNEL_DEVICETREE_BASENAME}.dtb \
    freescale/${KERNEL_DEVICETREE_BASENAME}-glt0701024600is2.dtb \
    freescale/${KERNEL_DEVICETREE_BASENAME}-glt1011280800is1.dtb \
"

KERNEL_DTB = "${KERNEL_DEVICETREE_BASENAME}.dtb"

UBOOT_DTB_NAME = "imx93-cargt-00324-00326.dtb"
UBOOT_CONFIG_BASENAME = "imx93-cargt-00324-00326"

DDR_FIRMWARE_NAME = " \
    lpddr4_dmem_1d_v202201.bin \
    lpddr4_dmem_2d_v202201.bin \
    lpddr4_imem_1d_v202201.bin \
    lpddr4_imem_2d_v202201.bin \
"

IMXBOOT_TARGETS = "flash_singleboot"

MACHINE_FEATURES:append = " dpdk rdp nxpwifi-all-sdio 00324 00326 "
MACHINE_FIRMWARE:append = " ethos-u-firmware "

WKS_FILE = "cargt-dev.wks.in"

PACKAGE_FEED_ARCHS = "all  armv8a  armv8a-mx93  imx93_cargt_00324_00326"
PACKAGE_FEED_BASE_PATHS = ""
PACKAGE_FEED_URIS = "https://yocto.cargt.com/linux-imx/scarthgap"
```

## conf/machine/imx93-cargt-00363-00428.conf
```bitbake
#@TYPE: Machine
#@NAME: Cargt NXP i.MX 93
#@SOC: i.MX93
#@DESCRIPTION: Machine configuration for Cargt NXP i.MX 93 00363 SOM on 00428 Carrier Board
#@MAINTAINER: Tim Carney <tim.carney@cargt.com>

MACHINEOVERRIDES =. "mx93:"

require include/imx93-cargt.inc

KERNEL_DEVICETREE_BASENAME = "imx93-cargt-00363-00428"

KERNEL_DEVICETREE = " \
    freescale/${KERNEL_DEVICETREE_BASENAME}.dtb \
    freescale/${KERNEL_DEVICETREE_BASENAME}-glt028240320is1.dtb \
    freescale/${KERNEL_DEVICETREE_BASENAME}-glt0557201280is1.dtb \
"

#KERNEL_DTB = "${KERNEL_DEVICETREE_BASENAME}.dtb"
KERNEL_DTB = "${KERNEL_DEVICETREE_BASENAME}-glt0557201280is1.dtb"

UBOOT_DTB_NAME = "imx93-cargt-00363-0048.dtb"
UBOOT_CONFIG_BASENAME = "imx93-cargt-00363-00428"

DDR_FIRMWARE_NAME = " \
    lpddr4_dmem_1d_v202201.bin \
    lpddr4_dmem_2d_v202201.bin \
    lpddr4_imem_1d_v202201.bin \
    lpddr4_imem_2d_v202201.bin \
"

IMXBOOT_TARGETS = "flash_singleboot"

MACHINE_FEATURES:append = " dpdk rdp nxpwifi-all-sdio 00363 00428 "
MACHINE_FIRMWARE:append = " ethos-u-firmware "

WKS_FILE = "cargt-dev.wks.in"

PACKAGE_FEED_ARCHS = "all  armv8a  armv8a-mx93  imx93_cargt_00363_osm_som imx93_cargt_00363_00428"
PACKAGE_FEED_BASE_PATHS = ""
PACKAGE_FEED_URIS = "https://yocto.cargt.com/linux-imx/scarthgap"
```

## conf/machine/imx93-cargt-00363-osm-som.conf
```bitbake
#@TYPE: Machine
#@NAME: Cargt NXP i.MX 93
#@SOC: i.MX93
#@DESCRIPTION: Machine configuration for Cargt NXP i.MX 93 00363 SOM
#@MAINTAINER: Tim Carney <tim.carney@cargt.com>

MACHINEOVERRIDES =. "mx93:"

require include/imx93-cargt.inc

KERNEL_DEVICETREE_BASENAME = "imx93-cargt-00363-osm-som"

KERNEL_DEVICETREE = " \
    freescale/${KERNEL_DEVICETREE_BASENAME}.dtb \
"

KERNEL_DTB = "${KERNEL_DEVICETREE_BASENAME}.dtb"

UBOOT_DTB_NAME = "imx93-cargt-00363-osm-som.dtb"
UBOOT_CONFIG_BASENAME = "imx93-cargt-00363-osm-som"

DDR_FIRMWARE_NAME = " \
    lpddr4_dmem_1d_v202201.bin \
    lpddr4_dmem_2d_v202201.bin \
    lpddr4_imem_1d_v202201.bin \
    lpddr4_imem_2d_v202201.bin \
"

IMXBOOT_TARGETS = "flash_singleboot"

MACHINE_FEATURES:append = " dpdk rdp nxpwifi-all-sdio 00363"
MACHINE_FIRMWARE:append = " ethos-u-firmware"

WKS_FILE = "cargt-dev.wks.in"

PACKAGE_FEED_ARCHS = "all  armv8a  armv8a-mx93  imx93_cargt_00363_osm_som"
PACKAGE_FEED_BASE_PATHS = ""
PACKAGE_FEED_URIS = "https://yocto.cargt.com/scarthgap"
```

## conf/machine/imx95-cargt-00414-00365.conf
```bitbake
#@TYPE: Machine
#@NAME: Cargt NXP i.MX 95
#@SOC: i.MX95
#@DESCRIPTION: Machine configuration for Cargt NXP i.MX 95 00414 OSM-L SOM on 00365 carrier
#@MAINTAINER: Tim Carney <tim.carney@cargt.com>

MACHINEOVERRIDES =. "mx95:"

require include/imx95-cargt-00414.inc

KERNEL_DEVICETREE_BASENAME = "imx95-cargt-00414-00365"

KERNEL_DEVICETREE = " \
    freescale/${KERNEL_DEVICETREE_BASENAME}.dtb \
    freescale/${KERNEL_DEVICETREE_BASENAME}-glt0557201280is1.dtb \
    freescale/${KERNEL_DEVICETREE_BASENAME}-glt1011280800is1.dtb \
"

KERNEL_DTB = "${KERNEL_DEVICETREE_BASENAME}.dtb"

UBOOT_DTB_NAME = "imx95-cargt-00414-00365.dtb"
UBOOT_CONFIG_BASENAME = "imx95-cargt-00414-00365"

MACHINE_FEATURES:append = " rdp 00414 00365 "

WKS_FILE = "cargt-dev.wks.in"

PACKAGE_FEED_ARCHS = "all  armv8a  armv8a-mx95  imx95_cargt_00414_osm_som imx95_cargt_00414_00365"
PACKAGE_FEED_BASE_PATHS = ""
PACKAGE_FEED_URIS = "https://yocto.cargt.com/linux-imx/wrynose"
```

## recipes-bsp/u-boot/u-boot-imx/files/configs/imx91-cargt-00363-00365_defconfig
```kconfig
#include <configs/imx91-cargt-00363-osm-som_defconfig>

CONFIG_DEFAULT_DEVICE_TREE="imx91-cargt-00363-00365"
CONFIG_DEFAULT_FDT_FILE="boot/imx91-cargt-00363-00365.dtb"
CONFIG_USB_TCPC=y
```

## recipes-bsp/u-boot/u-boot-imx/files/configs/imx93-cargt-00363-00365_defconfig
```kconfig
#include <configs/imx93-cargt-00363-osm-som_defconfig>

CONFIG_DEFAULT_DEVICE_TREE="imx93-cargt-00363-00365"
CONFIG_DEFAULT_FDT_FILE="boot/imx93-cargt-00363-00365.dtb"
CONFIG_USB_TCPC=y
```

## recipes-bsp/u-boot/u-boot-imx/files/configs/imx93-cargt-00363-00428_defconfig
```kconfig
#include <configs/imx93-cargt-00363-osm-som_defconfig>

CONFIG_DEFAULT_DEVICE_TREE="imx93-cargt-00363-00428"
CONFIG_DEFAULT_FDT_FILE="boot/imx93-cargt-00363-00428-glt0557201280is1.dtb"
CONFIG_USB_TCPC=y
```

## recipes-bsp/u-boot/u-boot-imx/files/configs/imx95-cargt-00414-00365_defconfig
```kconfig
#include <configs/imx95-cargt-00414-osm-som_defconfig>

CONFIG_DEFAULT_DEVICE_TREE="imx95-cargt-00414-00365"
CONFIG_DEFAULT_FDT_FILE="boot/imx95-cargt-00414-00365.dtb"
CONFIG_MDIO_GPIO_BITBANG=y
```

## recipes-bsp/u-boot/u-boot-imx/files/configs/imx95-cargt-00414-00428_defconfig
```kconfig
#include <configs/imx95-cargt-00414-osm-som_defconfig>

CONFIG_DEFAULT_DEVICE_TREE="imx95-cargt-00414-00428"
CONFIG_DEFAULT_FDT_FILE="boot/imx95-cargt-00414-00428.dtb"
```
